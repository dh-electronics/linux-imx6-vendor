/*
 * Copyright 2015 DH electronics GmbH
 *
 * This program is free software; you can redistribute it and/or modify
 * it under the terms of the GNU General Public License version 2 as
 * published by the Free Software Foundation.
 */

/dts-v1/;

//******************************************************************************
// C P U - T Y P E
//******************************************************************************
#include "imx6q.dtsi"
#define IMX6_CPU_DUAL_QUAD // Used to distinguish the CPU types
&cpu0 { // Use voltage settings after activating the PMIC
/*	operating-points = <
		// kHz      uV
		1200000     1350000  // Only for consumer type of product
		996000      1250000  // Only for consumer type of product
		852000      1250000
		792000      1175000
		396000      975000
	>;
	fsl,soc-operating-points = <
		// ARM kHz  SOC-PU uV
		1200000     1250000  // Only for consumer type of product
		996000      1250000  // Only for consumer type of product
		852000      1250000
		792000      1250000
		396000      1250000
	>;*/
};


//******************************************************************************
// D H C O M - M O D U L E
//******************************************************************************

// Basic configuration
//**********************************************************
// HW200 base
#include "imx6qdl-dhcom2B.dtsi"

// Special configurations
//**********************************************************
// Enables NAND, disables eMMC
//#include "imx6qdl-dhcom_cfg-nand.dtsi"


//******************************************************************************
// B O A R D - C O N F I G U R A T I O N
//******************************************************************************
#include "imx6qdl-dh_cfi2-200.dtsi"


/ {
	model = "Freescale i.MX6 Quad DHCOM CFI2-200";
	compatible = "fsl,imx6q-dhcom2B-cfi2-200", "fsl,imx6q";
};
